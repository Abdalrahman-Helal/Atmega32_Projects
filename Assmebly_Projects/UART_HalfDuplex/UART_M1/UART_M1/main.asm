;
; UART_M1.asm
;
; Created: 11/30/2023 11:22:08 AM
; Author : Abdalrahman
;


; Replace with your application code

init:
 LDI R16, LOW(RAMEND)
 OUT SPL,R16
 LDI R16, HIGH(RAMEND)
 OUT SPH,R16
 ; intialize PORTA as an input
 LDI R16, $00
 OUT DDRA,R16
 ; intialize PORTA as input PULL UP
 LDI R16, $FF
 OUT PORTA,R16
 
 ; intialize PORTC0 as an output Tx
 SBI DDRC,0
 
main:
;set PORTC 
	SBI PORTC,0
;DELAY THE START
	CALL Delay
	CALL Delay
	CALL Delay
	CALL Delay
	CALL Delay
	CALL Delay
	CALL Delay
	CALL Delay
;SEND START BIT 
	CBI PORTC,0
	CALL Delay
	CALL Delay
;CHECK FOR BUTTON0
	SBIS PINA,0
	SBI PORTC,0
	SBIC PINA,0
	CBI PORTC,0
	CALL Delay
	CALL Delay
;CHECK FOR BUTTON1
	SBIS PINA,1
	SBI PORTC,0
	SBIC PINA,1
	CBI PORTC,0
	CALL Delay
	CALL Delay
;CHECK FOR BUTTON2
	SBIS PINA,2
	SBI PORTC,0
	SBIC PINA,2
	CBI PORTC,0
	CALL Delay
	CALL Delay
	
;CHECK FOR BUTTON3
	SBIS PINA,3
	SBI PORTC,0
	SBIC PINA,3
	CBI PORTC,0
	CALL Delay
	CALL Delay
;CHECK FOR BUTTON4
	SBIS PINA,4
	SBI PORTC,0
	SBIC PINA,4
	CBI PORTC,0
	CALL Delay
	CALL Delay
;CHECK FOR BUTTON5
	SBIS PINA,5
	SBI PORTC,0
	SBIC PINA,5
	CBI PORTC,0
	CALL Delay
	CALL Delay
;CHECK FOR BUTTON6
	SBIS PINA,6
	SBI PORTC,0
	SBIC PINA,6
	CBI PORTC,0
	CALL Delay
	CALL Delay
;CHECK FOR BUTTON7
	SBIS PINA,7
	SBI PORTC,0
	SBIC pina,7
	cbi PORTC,0
	CALL Delay
	CALL Delay
; SEND STOP BIT
	SBI PORTC,0
	CALL Delay 
	CALL Delay
 
; THE DELAY TIME 
   RJMP MAIN
Delay:
	LDI R16,14
	NOP
	NOP
	LOOP:
	DEC R16
	BRNE LOOP
	RET




























